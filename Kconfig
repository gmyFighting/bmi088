## Kconfig
```kconfig
# Kconfig file for package bmi088
menuconfig PKG_USING_BMI088
    bool "Please add description of bmi088 in English."
    default n

if PKG_USING_BMI088

    config PKG_BMI088_PATH
        string
        default "/packages/peripherals/sensors/bmi088"

    choice
        prompt "Version"
        default PKG_USING_BMI088_LATEST_VERSION
        help
            Select the package version

        config PKG_USING_BMI088_V[100]
            bool "v1.0.0"

        config PKG_USING_BMI088_LATEST_VERSION
            bool "latest"
    endchoice
          
    config PKG_BMI088_VER
       string
       default "v1.0.0"    if PKG_USING_BMI088_V[100]
       default "latest"    if PKG_USING_BMI088_LATEST_VERSION

endif
```
